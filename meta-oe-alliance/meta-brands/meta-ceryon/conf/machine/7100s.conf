## meta-oe-alliance/meta-brands/meta-ceryon/conf/machine/7100s.conf
```bitbake
SOC_FAMILY = "bcm7362"

require conf/machine/include/ceryon-oem.inc

MACHINE_FEATURES += "colorlcd220 lcd220 ci"

MACHINE_EXTRA_RRECOMMENDS += " \
    ceryon-lcd \
"

MACHINE_EXTRA_RDEPENDS = "\
    ${@bb.utils.contains('MACHINEBUILD', 'twinboxlcd', 'rt3070 firmware-rt2870' , '', d)} \
    ${@bb.utils.contains('MACHINEBUILD', 'twinboxlcd', 'rt3070 firmware-rt3070' , '', d)} \
    "
```
